## drivers/modem/Kconfig.ublox-sara-r41xx
```kconfig
# Kconfig - U-Blox SARA R41xx driver options

#
# Copyright (c) 2019 Foundries.io
#
# SPDX-License-Identifier: Apache-2.0
#

config MODEM_UBLOX_SARA_R41XX
	bool "Enable U-Blox SARA-R41xx LTE-M modem driver"
	select MODEM_RECEIVER
	select NET_OFFLOAD
	imply GPIO
	help
	  Choose this setting to enable U-Blox SARA-R41xx LTE-M modem driver.
	  NOTE: Currently the pin settings only work with FRDM K64F shield.

if MODEM_UBLOX_SARA_R41XX

config MODEM_UBLOX_SARA_R41XX_RX_STACK_SIZE
	int "Stack size for the U-Blox SARA-R41xx modem driver RX thread"
	default 1028
	help
	  This stack is used by the U-Blox SARA-R41xx RX thread.

config MODEM_UBLOX_SARA_R41XX_RX_WORKQ_STACK_SIZE
	int "Stack size for the U-Blox SARA-R41xx modem driver work queue"
	default 2048
	help
	  This stack is used by the work queue to pass off net_pkt data
	  to the rest of the network stack, letting the rx thread continue
	  processing data.

config MODEM_UBLOX_SARA_R41XX_OPERATOR
	string "APN for establishing network connection"
	default "m2m.com.attz"
	help
	  This setting is used in the AT+CGDCONT command to set the APN name
	  for the network connection context.  This value is specific to
	  the network provider and may need to be changed.

config MODEM_UBLOX_SARA_R41XX_INIT_PRIORITY
	int "U-Blox SARA-R41xx driver init priority"
	default 80
	help
	  U-Blox SARA-R41xx device driver initialization priority.
	  Do not mess with it unless you know what you are doing.
	  Note that the priority needs to be lower than the net stack
	  so that it can start before the networking sub-system.

endif # MODEM_UBLOX_SARA_R41XX
```

## dts/bindings/modem/ublox,sara-r41xx.yaml
```yaml
#
# Copyright (c) 2018, Foundries.io
#
# SPDX-License-Identifier: Apache-2.0
#
---
title: U-Blox SARA-R41xx Modem
version: 0.1

description: >
    This is a representation of the U-Blox SARA-R41xx modem.

inherits:
    !include uart-device.yaml

properties:
    compatible:
      type: string
      category: required
      constraint: "ublox,sara-r41xx"
      generation: define

    mdm-power-gpios-gpio:
      type: compound
      category: required
      generation: define, use-prop-name

    mdm-reset-gpios-gpio:
      type: compound
      category: required
      generation: define, use-prop-name
...
```
